## boards/shields/pepuinoSplit44/Kconfig.defconfig
```kconfig
if SHIELD_PEPUINO_SPLIT_LEFT

# Name must be less than 16 characters long!
config ZMK_KEYBOARD_NAME
    default "Pepuino Split 44"

config ZMK_SPLIT_ROLE_CENTRAL
    default y

endif

if SHIELD_PEPUINO_SPLIT_LEFT || SHIELD_PEPUINO_SPLIT_RIGHT

config ZMK_SPLIT
    default y

endif
```

## boards/shields/pepuino_split/Kconfig.shield
```kconfig
# No whitespace after the comma or in your part name!
config SHIELD_PEPUINO_SPLIT_LEFT
    def_bool $(shields_list_contains,pepuino_split_left)

# No whitespace after the comma or in your part name!
config SHIELD_PEPUINO_SPLIT_RIGHT
    def_bool $(shields_list_contains,pepuino_split_right)
```
